#include <Wire.h>
#include <SPI.h>
#include <string.h>
#include <pgmspace.h>

#include <Adafruit_PN532.h>
#include <LiquidCrystal.h>

#include <Adafruit_GFX.h>
#include <Adafruit_ILI9341.h>


// =====================================================
// REAL GUELPH GRYPHONS LOGO
// Embedded directly in this sketch. No extra .h file.
// =====================================================

#define GUELPH_LOGO_SMALL_WIDTH 44
#define GUELPH_LOGO_SMALL_HEIGHT 44
const uint16_t guelph_logo_small[GUELPH_LOGO_SMALL_WIDTH * GUELPH_LOGO_SMALL_HEIGHT] PROGMEM = {
0xF7BE, 0xF7BE, 0xF7BE, 0xF7BE, 0xF7BE, 0xF7BE, 0xF7BE, 0xF7BE, 0xF7BE, 0xF7BE, 0xF7BE, 0xF7BE,
0xF7BE, 0xF7BE, 0xF7BE, 0xF7BE, 0xF7BE, 0xF7BE, 0xF7BE, 0xF7BE, 0xF7BE, 0xF7BE, 0xF7BE, 0xF7BE,
0xF7BE, 0xF7BE, 0xF7BE, 0xF7BE, 0xF7BE, 0xF7BE, 0xF7BE, 0xF7BE, 0xF7BE, 0xF7BE, 0xF7BE, 0xF7BE,
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0xFFDF, 0xFFDF, 0xFFDF, 0xFFDF
};


// =====================================================
// IR REMOTE
// =====================================================

#define IR_RECEIVE_PIN 34

#include <TinyIRReceiver.hpp>

#define POWER_COMMAND 0x45


// =====================================================
// PN532
// =====================================================

#define PN532_SDA 21
#define PN532_SCL 22

#define PN532_IRQ   35
#define PN532_RESET 13

Adafruit_PN532 nfc(
  PN532_IRQ,
  PN532_RESET,
  &Wire
);


// =====================================================
// LCD1602
// =====================================================

#define LCD_RS 16
#define LCD_EN 19
#define LCD_D4 4
#define LCD_D5 5
#define LCD_D6 2
#define LCD_D7 15

LiquidCrystal lcd(
  LCD_RS,
  LCD_EN,
  LCD_D4,
  LCD_D5,
  LCD_D6,
  LCD_D7
);

// Custom smiling-face character for the 16x2 LCD.
// Stored in CGRAM slot 0.
byte lcdSmiley[8] = {
  B00000,
  B01010,
  B01010,
  B00000,
  B10001,
  B01110,
  B00000,
  B00000
};


// =====================================================
// TFT
// =====================================================

#define TFT_CS   32
#define TFT_RST  33
#define TFT_DC   27
#define TFT_MOSI 23
#define TFT_SCK  18

SPIClass tftSPI(VSPI);

Adafruit_ILI9341 tft(
  &tftSPI,
  TFT_DC,
  TFT_CS,
  TFT_RST
);


// =====================================================
// CUSTOM TFT COLORS
// =====================================================

const uint16_t COLOR_BG          = 0x0841;
const uint16_t COLOR_HEADER      = 0x8000;
const uint16_t COLOR_HEADER_DARK = 0x5000;
const uint16_t COLOR_PANEL       = 0x18E3;
const uint16_t COLOR_PANEL_2     = 0x2124;
const uint16_t COLOR_WHITE_SOFT  = 0xEF7D;
const uint16_t COLOR_MUTED       = 0x94B2;
const uint16_t COLOR_GOLD        = 0xFE40;
const uint16_t COLOR_GREEN       = 0x04E0;
const uint16_t COLOR_GREEN_DARK  = 0x02E0;
const uint16_t COLOR_RED         = 0xE800;
const uint16_t COLOR_RED_DARK    = 0xA800;
const uint16_t COLOR_YELLOW      = 0xFFE0;
const uint16_t COLOR_YELLOW_DARK = 0xD5A0;
const uint16_t COLOR_BLUE        = 0x04DF;
const uint16_t COLOR_BLUE_DARK   = 0x02B5;


// =====================================================
// SYSTEM STATE
// =====================================================

bool systemActive = false;
bool showingCard = false;
bool cardLatched = false;

unsigned long cardScreenStarted = 0;
unsigned long nextRFIDPollAt = 0;

uint8_t noCardStreak = 0;


// =====================================================
// TIMING
// =====================================================

const unsigned long CARD_SCREEN_TIME = 3500;
const unsigned long RFID_POLL_INTERVAL = 100;
const unsigned long RFID_REARM_DELAY = 700;
const uint8_t NO_CARD_READS_TO_UNLOCK = 2;


// =====================================================
// CARD STATUS
// =====================================================

enum CardStatus {
  STATUS_APPROVED,
  STATUS_WARNING,
  STATUS_DENIED,
  STATUS_UNKNOWN
};

struct CardRecord {
  const char* uid;
  const char* name;
  CardStatus status;
  const char* message;
};


// =====================================================
// INTENTIONALLY UNKNOWN DEMO CARDS
// =====================================================

const char* forcedUnknownUIDs[] = {
  "A4:B1:76:E7",
  "3C:23:48:42",
  "DC:65:0C:42"
};

const uint8_t forcedUnknownCount =
  sizeof(forcedUnknownUIDs) / sizeof(forcedUnknownUIDs[0]);


// =====================================================
// CARD DATABASE
// =====================================================

const CardRecord cardDatabase[] = {
  { "47:07:12:5E", "BURAK AKSOY",    STATUS_APPROVED, "Membership active" },
  { "60:11:9D:5C", "FATIH AKSOY",    STATUS_APPROVED, "Membership active" },
  { "6C:BD:1C:42", "AYLIN DEMIR",     STATUS_APPROVED, "Membership active" },
  { "4C:AA:21:42", "SELIN ARSLAN",    STATUS_APPROVED, "Membership active" },
  { "1C:DB:26:42", "MERT AYDIN",      STATUS_APPROVED, "Membership active" },
  { "CC:3D:2D:42", "KEREM CELIK",     STATUS_APPROVED, "Membership active" },

  { "26:8C:75:E7", "EYLUL HEPOGLU",   STATUS_WARNING,  "Membership expires in 6 days" },
  { "3C:A2:42:42", "CAN YILDIRIM",    STATUS_WARNING,  "Membership expires in 3 days" },

  { "0C:28:13:42", "ELIF SAHIN",      STATUS_DENIED,   "Membership expired" },
  { "BC:7C:1E:42", "EMRE YILMAZ",     STATUS_DENIED,   "Access denied" },
  { "8C:2B:20:42", "ONUR KAPLAN",     STATUS_DENIED,   "Access denied" }
};

const uint8_t cardCount =
  sizeof(cardDatabase) / sizeof(cardDatabase[0]);

const CardRecord unknownCard = {
  "UNKNOWN",
  "UNKNOWN MEMBER",
  STATUS_UNKNOWN,
  "Unknown card"
};


// =====================================================
// CARD LOOKUP
// =====================================================

bool isForcedUnknownCard(const char* uid) {
  for (uint8_t i = 0; i < forcedUnknownCount; i++) {
    if (strcmp(uid, forcedUnknownUIDs[i]) == 0) {
      return true;
    }
  }
  return false;
}

const CardRecord* findCardByUID(const char* uid) {
  if (isForcedUnknownCard(uid)) {
    return &unknownCard;
  }

  for (uint8_t i = 0; i < cardCount; i++) {
    if (strcmp(uid, cardDatabase[i].uid) == 0) {
      return &cardDatabase[i];
    }
  }

  return &unknownCard;
}


// =====================================================
// CENTERED TFT TEXT
// =====================================================

void centeredText(
  const char *text,
  int16_t y,
  uint8_t size,
  uint16_t color
) {
  int16_t x1;
  int16_t y1;
  uint16_t width;
  uint16_t height;

  tft.setTextSize(size);
  tft.setTextColor(color);
  tft.getTextBounds(text, 0, y, &x1, &y1, &width, &height);

  int16_t x = (tft.width() - width) / 2;
  if (x < 2) x = 2;

  tft.setCursor(x, y);
  tft.print(text);
}

void centeredTextOnBackground(
  const char *text,
  int16_t y,
  uint8_t size,
  uint16_t foreground,
  uint16_t background
) {
  int16_t x1;
  int16_t y1;
  uint16_t width;
  uint16_t height;

  tft.setTextSize(size);
  tft.setTextColor(foreground, background);
  tft.getTextBounds(text, 0, y, &x1, &y1, &width, &height);

  int16_t x = (tft.width() - width) / 2;
  if (x < 2) x = 2;

  tft.setCursor(x, y);
  tft.print(text);
}


// =====================================================
// REAL GUELPH LOGO HEADER
// Only the header changed. The rest of the UI is kept.
// =====================================================

void drawBrandHeader() {
  tft.fillRect(0, 0, 240, 94, COLOR_HEADER_DARK);
  tft.fillRect(0, 0, 240, 5, COLOR_GOLD);

  // Logo area, top-left.
  // Original supplied Guelph Gryphons logo is 44x44 here.
  tft.drawRGBBitmap(
    10,
    13,
    guelph_logo_small,
    GUELPH_LOGO_SMALL_WIDTH,
    GUELPH_LOGO_SMALL_HEIGHT
  );

  // Text beside logo.
  tft.setTextWrap(false);

  tft.setTextSize(2);
  tft.setTextColor(ILI9341_WHITE);
  tft.setCursor(62, 20);
  tft.print("GRYPHON");

  tft.setCursor(62, 40);
  tft.print("FIT & REC");

  tft.setTextSize(1);
  tft.setTextColor(COLOR_WHITE_SOFT);
  tft.setCursor(62, 64);
  tft.print("UNIVERSITY OF GUELPH");

  tft.drawLine(18, 93, 222, 93, COLOR_GOLD);
}


// =====================================================
// MAIN INFORMATION PANEL
// =====================================================

void drawMainPanel() {
  tft.fillRoundRect(12, 102, 216, 205, 12, COLOR_PANEL);
  tft.drawRoundRect(12, 102, 216, 205, 12, COLOR_MUTED);
}


// =====================================================
// STATUS ICONS
// =====================================================

void drawApprovedIcon(int cx, int cy) {
  tft.fillCircle(cx, cy, 27, COLOR_GREEN_DARK);
  tft.drawCircle(cx, cy, 27, COLOR_GREEN);
  tft.drawCircle(cx, cy, 28, ILI9341_WHITE);

  tft.drawLine(cx - 12, cy, cx - 3, cy + 11, ILI9341_WHITE);
  tft.drawLine(cx - 11, cy + 1, cx - 2, cy + 12, ILI9341_WHITE);
  tft.drawLine(cx - 3, cy + 11, cx + 15, cy - 12, ILI9341_WHITE);
  tft.drawLine(cx - 2, cy + 12, cx + 16, cy - 11, ILI9341_WHITE);
}

void drawDeniedIcon(int cx, int cy) {
  tft.fillCircle(cx, cy, 27, COLOR_RED_DARK);
  tft.drawCircle(cx, cy, 27, COLOR_RED);
  tft.drawCircle(cx, cy, 28, ILI9341_WHITE);

  tft.drawLine(cx - 12, cy - 12, cx + 12, cy + 12, ILI9341_WHITE);
  tft.drawLine(cx - 11, cy - 12, cx + 13, cy + 12, ILI9341_WHITE);
  tft.drawLine(cx - 12, cy + 12, cx + 12, cy - 12, ILI9341_WHITE);
  tft.drawLine(cx - 11, cy + 12, cx + 13, cy - 12, ILI9341_WHITE);
}

void drawWarningIcon(int cx, int cy) {
  tft.fillTriangle(
    cx,
    cy - 29,
    cx - 29,
    cy + 23,
    cx + 29,
    cy + 23,
    COLOR_YELLOW_DARK
  );

  tft.drawTriangle(
    cx,
    cy - 29,
    cx - 29,
    cy + 23,
    cx + 29,
    cy + 23,
    ILI9341_WHITE
  );

  tft.fillRoundRect(cx - 2, cy - 11, 5, 20, 2, ILI9341_BLACK);
  tft.fillCircle(cx, cy + 15, 3, ILI9341_BLACK);
}

void drawRFIDReadyIcon() {
  const int x = 91;
  const int y = 121;

  tft.fillRoundRect(x, y, 58, 46, 7, COLOR_BLUE_DARK);
  tft.drawRoundRect(x, y, 58, 46, 7, ILI9341_WHITE);

  tft.drawLine(x + 10, y + 12, x + 39, y + 12, ILI9341_WHITE);
  tft.drawLine(x + 10, y + 20, x + 31, y + 20, ILI9341_WHITE);

  tft.drawCircle(x + 46, y + 28, 5, COLOR_GOLD);
  tft.drawCircle(x + 46, y + 28, 9, COLOR_GOLD);
}


// =====================================================
// FAST TFT RENDERING
//
// The header, real Guelph logo, and panel frame are
// STATIC. They are drawn only once at startup.
//
// During ACTIVE / STOPPED / CARD result transitions,
// only the changing content inside the panel is erased
// and redrawn. This keeps the proven 1 MHz SPI speed
// and avoids touching the working PN532/TFT logic.
// =====================================================

void drawStaticFrame() {
  tft.fillScreen(COLOR_BG);
  drawBrandHeader();
  drawMainPanel();
}


// =====================================================
// CLEAR ONLY DYNAMIC PANEL CONTENT
//
// These three rectangles cover every changing item:
// - status / RFID icon
// - status text, member name, reason
// - action bar and UID/footer
//
// They stay inside the existing rounded panel border,
// so the header, logo, panel frame, and design remain
// untouched between screen changes.
// =====================================================

void clearDynamicContent() {
  // Icon area
  tft.fillRect(
    70,
    107,
    100,
    69,
    COLOR_PANEL
  );

  // Main status / name / message area
  tft.fillRect(
    20,
    176,
    200,
    72,
    COLOR_PANEL
  );

  // Action bar + footer / UID area
  tft.fillRect(
    35,
    240,
    170,
    64,
    COLOR_PANEL
  );
}


// =====================================================
// TFT SCREENS
// =====================================================

void showStoppedScreen() {
  clearDynamicContent();

  drawDeniedIcon(120, 143);

  centeredText("SYSTEM STOPPED", 181, 2, ILI9341_WHITE);
  centeredText("Reader is offline", 211, 1, COLOR_MUTED);

  tft.fillRoundRect(52, 241, 136, 34, 8, COLOR_RED_DARK);
  centeredTextOnBackground(
    "PRESS POWER",
    252,
    2,
    ILI9341_WHITE,
    COLOR_RED_DARK
  );

  centeredText("ACCESS CONTROL SYSTEM", 290, 1, COLOR_MUTED);
}

void showReadyScreen() {
  clearDynamicContent();

  drawRFIDReadyIcon();

  centeredText("SYSTEM ACTIVE", 184, 2, COLOR_GREEN);
  centeredText("Scan your membership card", 213, 1, COLOR_WHITE_SOFT);

  tft.fillRoundRect(45, 241, 150, 32, 8, COLOR_BLUE_DARK);
  centeredTextOnBackground(
    "RFID READER READY",
    252,
    1,
    ILI9341_WHITE,
    COLOR_BLUE_DARK
  );

  centeredText("Tap card above reader", 288, 1, COLOR_MUTED);
}

void showResultScreen(
  const CardRecord* record,
  const char* uid
) {
  clearDynamicContent();

  if (record->status == STATUS_APPROVED) {
    drawApprovedIcon(120, 139);
    centeredText("ACCESS APPROVED", 176, 2, COLOR_GREEN);
    centeredText(record->name, 207, 2, COLOR_GOLD);
    centeredText(record->message, 236, 1, COLOR_WHITE_SOFT);

    tft.fillRoundRect(66, 256, 108, 24, 6, COLOR_GREEN_DARK);
    centeredTextOnBackground(
      "ENTRY ALLOWED",
      264,
      1,
      ILI9341_WHITE,
      COLOR_GREEN_DARK
    );
  }
  else if (record->status == STATUS_WARNING) {
    drawWarningIcon(120, 139);
    centeredText("ACCESS APPROVED", 176, 2, COLOR_YELLOW);
    centeredText(record->name, 207, 2, COLOR_GOLD);
    centeredText(record->message, 235, 1, COLOR_YELLOW);

    tft.fillRoundRect(50, 256, 140, 24, 6, COLOR_YELLOW_DARK);
    centeredTextOnBackground(
      "MEMBERSHIP WARNING",
      264,
      1,
      ILI9341_BLACK,
      COLOR_YELLOW_DARK
    );
  }
  else if (record->status == STATUS_DENIED) {
    drawDeniedIcon(120, 139);
    centeredText("ACCESS DENIED", 176, 2, COLOR_RED);
    centeredText(record->name, 207, 2, COLOR_GOLD);
    centeredText(record->message, 236, 1, COLOR_WHITE_SOFT);

    tft.fillRoundRect(66, 256, 108, 24, 6, COLOR_RED_DARK);
    centeredTextOnBackground(
      "NO ENTRY",
      264,
      1,
      ILI9341_WHITE,
      COLOR_RED_DARK
    );
  }
  else {
    drawDeniedIcon(120, 139);
    centeredText("ACCESS DENIED", 176, 2, COLOR_RED);
    centeredText("UNKNOWN MEMBER", 207, 2, COLOR_GOLD);
    centeredText("Unknown card", 236, 1, COLOR_WHITE_SOFT);

    tft.fillRoundRect(52, 256, 136, 24, 6, COLOR_RED_DARK);
    centeredTextOnBackground(
      "CARD NOT REGISTERED",
      264,
      1,
      ILI9341_WHITE,
      COLOR_RED_DARK
    );
  }

  tft.fillRoundRect(42, 285, 156, 16, 4, COLOR_PANEL_2);
  centeredTextOnBackground(
    uid,
    289,
    1,
    COLOR_MUTED,
    COLOR_PANEL_2
  );
}


// =====================================================
// LCD HELPERS
// =====================================================

void lcdPrintTwoLines(
  const char* line1,
  const char* line2
) {
  lcd.clear();
  lcd.setCursor(0, 0);
  lcd.print(line1);
  lcd.setCursor(0, 1);
  lcd.print(line2);
}

void showLCDGreeting() {
  lcd.clear();

  // 15 characters. Fits cleanly on row 1.
  lcd.setCursor(0, 0);
  lcd.print("WELCOME! HAVE A");

  // 15 normal characters + custom smiley = exactly 16 columns.
  lcd.setCursor(0, 1);
  lcd.print("GREAT WORKOUT! ");
  lcd.write((uint8_t)0);
}

void showLCDReady() {
  showLCDGreeting();
}

void showLCDStopped() {
  showLCDGreeting();
}

void showLCDResult(const CardRecord* record) {
  // Keep the LCD as a permanent greeting display.
  // Card-specific status remains on the TFT only.
  (void)record;
  showLCDGreeting();
}


// =====================================================
// UID -> TEXT
// =====================================================

void uidToText(
  uint8_t *uid,
  uint8_t uidLength,
  char *output,
  size_t outputSize
) {
  if (outputSize == 0) return;

  output[0] = '\0';
  size_t used = 0;

  for (uint8_t i = 0; i < uidLength; i++) {
    int written = snprintf(
      output + used,
      outputSize - used,
      (i == 0) ? "%02X" : ":%02X",
      uid[i]
    );

    if (written <= 0) break;

    used += (size_t)written;

    if (used >= outputSize) {
      output[outputSize - 1] = '\0';
      break;
    }
  }
}


// =====================================================
// PN532 LOW-LEVEL RESPONSE
// Working logic preserved.
// =====================================================

bool readSimplePN532Response(uint8_t expectedResponseCommand) {
  uint8_t raw[10] = {0};

  uint8_t received = Wire.requestFrom(
    (uint8_t)PN532_I2C_ADDRESS,
    (uint8_t)sizeof(raw)
  );

  if (received != sizeof(raw)) {
    while (Wire.available()) Wire.read();
    return false;
  }

  for (uint8_t i = 0; i < sizeof(raw); i++) {
    if (!Wire.available()) return false;
    raw[i] = Wire.read();
  }

  if (raw[0] != PN532_I2C_READY) return false;

  uint8_t *f = &raw[1];

  if (f[0] != 0x00 || f[1] != 0x00 || f[2] != 0xFF) return false;
  if (f[3] != 0x02 || f[4] != 0xFE) return false;
  if (f[5] != PN532_PN532TOHOST) return false;
  if (f[6] != expectedResponseCommand) return false;

  if (((uint8_t)(f[5] + f[6] + f[7])) != 0x00) return false;
  if (f[8] != 0x00) return false;

  return true;
}

bool readStatusPN532Response(
  uint8_t expectedResponseCommand,
  uint8_t &status
) {
  uint8_t raw[11] = {0};

  uint8_t received = Wire.requestFrom(
    (uint8_t)PN532_I2C_ADDRESS,
    (uint8_t)sizeof(raw)
  );

  if (received != sizeof(raw)) {
    while (Wire.available()) Wire.read();
    return false;
  }

  for (uint8_t i = 0; i < sizeof(raw); i++) {
    if (!Wire.available()) return false;
    raw[i] = Wire.read();
  }

  if (raw[0] != PN532_I2C_READY) return false;

  uint8_t *f = &raw[1];

  if (f[0] != 0x00 || f[1] != 0x00 || f[2] != 0xFF) return false;
  if (f[3] != 0x03 || f[4] != 0xFD) return false;
  if (f[5] != PN532_PN532TOHOST) return false;
  if (f[6] != expectedResponseCommand) return false;

  status = f[7];

  if (((uint8_t)(f[5] + f[6] + f[7] + f[8])) != 0x00) return false;
  if (f[9] != 0x00) return false;

  return true;
}

bool configureFinitePassiveRetries(uint8_t retries) {
  uint8_t command[5] = {
    PN532_COMMAND_RFCONFIGURATION,
    0x05,
    0xFF,
    0x01,
    retries
  };

  if (!nfc.sendCommandCheckAck(command, sizeof(command), 1000)) {
    return false;
  }

  delay(2);

  return readSimplePN532Response(
    PN532_COMMAND_RFCONFIGURATION + 1
  );
}

bool turnRFOffClean() {
  uint8_t command[3] = {
    PN532_COMMAND_RFCONFIGURATION,
    0x01,
    0x00
  };

  if (!nfc.sendCommandCheckAck(command, sizeof(command), 1000)) {
    return false;
  }

  delay(2);

  return readSimplePN532Response(
    PN532_COMMAND_RFCONFIGURATION + 1
  );
}

bool releaseTargetClean() {
  uint8_t command[2] = {
    PN532_COMMAND_INRELEASE,
    0x00
  };

  if (!nfc.sendCommandCheckAck(command, sizeof(command), 1000)) {
    return false;
  }

  delay(2);

  uint8_t status = 0xFF;

  if (!readStatusPN532Response(
        PN532_COMMAND_INRELEASE + 1,
        status
      )) {
    return false;
  }

  return (status == 0x00);
}

bool finishCardSessionClean() {
  bool released = releaseTargetClean();
  bool rfOff = turnRFOffClean();

  delay(40);

  return (released && rfOff);
}


// =====================================================
// SYSTEM CONTROL
// =====================================================

void activateSystem() {
  systemActive = true;
  showingCard = false;
  cardLatched = false;
  noCardStreak = 0;

  showLCDReady();
  showReadyScreen();

  nextRFIDPollAt = millis() + 100;

  Serial.println("SYSTEM ACTIVE");
}

void stopSystem() {
  systemActive = false;
  showingCard = false;
  cardLatched = false;
  noCardStreak = 0;

  bool rfOff = turnRFOffClean();

  if (!rfOff) {
    delay(10);
    rfOff = turnRFOffClean();
  }

  if (!rfOff) {
    Serial.println("ERROR: Could not shut PN532 RF field down.");
    lcdPrintTwoLines("RFID ERROR", "Restart system");
    return;
  }

  delay(30);

  showLCDStopped();
  showStoppedScreen();

  Serial.println("SYSTEM STOPPED");
}


// =====================================================
// IR REMOTE
// =====================================================

void checkRemote() {
  if (!TinyIRReceiverDecode()) return;

  uint8_t command = TinyIRReceiverData.Command;

  bool repeat =
    TinyIRReceiverData.Flags &
    IRDATA_FLAGS_IS_REPEAT;

  if (repeat) return;
  if (command != POWER_COMMAND) return;

  if (systemActive) {
    stopSystem();
  } else {
    activateSystem();
  }
}


// =====================================================
// CARD SCREEN TIMER
// =====================================================

void updateCardScreen() {
  if (!showingCard) return;

  if (millis() - cardScreenStarted < CARD_SCREEN_TIME) return;

  showingCard = false;

  if (!systemActive) return;

  showLCDReady();
  showReadyScreen();

  nextRFIDPollAt = millis() + RFID_REARM_DELAY;
}


// =====================================================
// RFID POLLING
// Working logic preserved.
// =====================================================

void pollRFID() {
  if (!systemActive) return;
  if (showingCard) return;

  unsigned long now = millis();

  if ((long)(now - nextRFIDPollAt) < 0) return;

  nextRFIDPollAt = now + RFID_POLL_INTERVAL;

  uint8_t uid[7] = {0};
  uint8_t uidLength = 0;

  bool detected = nfc.readPassiveTargetID(
    PN532_MIFARE_ISO14443A,
    uid,
    &uidLength,
    500
  );

  if (!detected) {
    checkRemote();

    if (!systemActive) return;

    if (cardLatched) {
      noCardStreak++;

      if (noCardStreak >= NO_CARD_READS_TO_UNLOCK) {
        cardLatched = false;
        noCardStreak = 0;
        Serial.println("CARD REMOVED");
      }
    }

    return;
  }

  bool sessionClean = finishCardSessionClean();

  checkRemote();

  if (!systemActive) return;

  if (!sessionClean) {
    Serial.println("ERROR: PN532 SESSION CLEANUP FAILED");
    systemActive = false;
    lcdPrintTwoLines("RFID ERROR", "Restart system");
    return;
  }

  noCardStreak = 0;

  if (uidLength != 4 && uidLength != 7) {
    Serial.print("INVALID UID LENGTH: ");
    Serial.println(uidLength);
    return;
  }

  if (cardLatched) return;

  cardLatched = true;

  char uidText[24];

  uidToText(
    uid,
    uidLength,
    uidText,
    sizeof(uidText)
  );

  Serial.print("CARD DETECTED: ");
  Serial.println(uidText);

  const CardRecord* record = findCardByUID(uidText);

  showLCDResult(record);
  showResultScreen(record, uidText);

  showingCard = true;
  cardScreenStarted = millis();
}


// =====================================================
// SETUP
// =====================================================

void setup() {
  Serial.begin(115200);
  delay(1500);

  Serial.println();
  Serial.println("================================");
  Serial.println("GRYPHON ACCESS UI REAL LOGO");
  Serial.println("================================");

  lcd.begin(16, 2);
  lcd.createChar(0, lcdSmiley);

  pinMode(TFT_CS, OUTPUT);
  digitalWrite(TFT_CS, HIGH);

  pinMode(TFT_RST, OUTPUT);
  digitalWrite(TFT_RST, HIGH);

  tftSPI.begin(
    TFT_SCK,
    -1,
    TFT_MOSI,
    TFT_CS
  );

  tft.begin(1000000);
  tft.setRotation(0);

  Wire.begin(
    PN532_SDA,
    PN532_SCL
  );

  Serial.println("Starting PN532...");

  nfc.begin();
  delay(200);

  uint32_t versiondata = nfc.getFirmwareVersion();

  if (!versiondata) {
    Serial.println("PN532 NOT DETECTED");
    while (true) delay(1000);
  }

  Serial.print("PN532 firmware: ");
  Serial.print((versiondata >> 16) & 0xFF);
  Serial.print(".");
  Serial.println((versiondata >> 8) & 0xFF);

  if (!configureFinitePassiveRetries(0x01)) {
    Serial.println("PN532 RETRY CONFIGURATION FAILED");
    while (true) delay(1000);
  }

  Serial.println("PN532 finite scan mode configured.");

  if (!turnRFOffClean()) {
    Serial.println("PN532 INITIAL RF OFF FAILED");
    while (true) delay(1000);
  }

  if (!initPCIInterruptForTinyIRReceiver()) {
    Serial.println("IR INITIALIZATION FAILED");
    while (true) delay(1000);
  }

  systemActive = false;
  showingCard = false;
  cardLatched = false;
  noCardStreak = 0;

  // Draw the expensive static header/logo/panel only once.
  drawStaticFrame();

  showLCDStopped();
  showStoppedScreen();

  Serial.println("SYSTEM READY");
}


// =====================================================
// LOOP
// =====================================================

void loop() {
  checkRemote();
  updateCardScreen();
  pollRFID();
  delay(1);
}
